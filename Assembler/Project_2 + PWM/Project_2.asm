/*
Работа с ШИМ (Коррекция по фазе)
Диод подключен к выводу PD5 (OC0B)
MK:	ATtiny2313
Тактовая частота:	1 MHz
*/

.include "tn2313def.inc"    //Файл описания

.def	temp	=R16
.def	count	=R17		//Счетчик хранения значения
.def	loop	=R18		//Петля счета

.equ	DelayMax = 0x3F


.cseg
.org	(0x00)




init:
	ldi	temp,RAMEND			;Инициализация стека
	out	SPL,temp

	
	
	ser temp				;единица во всем регистре
	out DDRD,temp			;Порт D на выход
	ldi temp, 0xDF
	out	PORTD,temp			;Все вывода порта в высокий уровень
	
	/*
	ldi		temp,(1<<PB5)	;Все выводы порта D, за исключением PD5, на вход.
	out		DDRD,temp		;PD5 на выход
	ser		temp			;На всех выводах порта D включены подтягивающие резисторы.
	out		PORTD,temp
	*/



	/*_______________________________________________________________*/
	;и OC0A и OC0B должны быть переведены на выход?
	 
	ser temp				//единица во всем регистре
	out DDRB,temp			//Порт В на выход
	out	PORTB,temp			//Все вывода порта в высокий уровень
	
	/*___________________________________________________________________*/

	/*___________________________________________________________________*/
	/* поэтапная запись настройки ШИМ 
	Данная настройка невозможна
	ldi temp,(0<<WGM02)	;Включение режима ШИМ с коррекктировкой по фазе
	out	TCCR0B, temp

	ldi temp,(0<<WGM01|1<<WGM00);Включение режима ШИМ с коррекктировкой по фазе
	out TCCR0A, temp

	ldi temp,(1<<COM0B1|1<<COM0B0)	;настройка PD5 (OC0B)
	out	TCCR0A,temp
	
	
	ldi temp,(1<<COM0A1|0<<COM0A0)	;настройка PB2 (OC0F)		
	out	TCCR0A,temp
	*/
	/*_________________________________________________*/
	; объединенная запись настройки
	
	ldi temp,(1<<COM0B1|1<<COM0B0|1<<COM0A1|0<<COM0A0|0<<WGM01|1<<WGM00)	;настройка PD5 (OC0B)
	out	TCCR0A,temp
		
	/*_________________________________________________*/
	
	
	
	
	ldi temp,(0<<CS02|0<<CS01|1<<CS00|0<<WGM02)	;включение таймера с делением на 1
	out	TCCR0B,temp

	ldi count,0			;загрузили в регистр начальное значение
	


main:
		
		
up:		nop
		out OCR0B, count
		rcall Pause
		inc count				// Изменили значение уровня ШИМ
		brne up
down:	out OCR0B, count
		rcall Pause
		dec count			// Изменили значение уровня ШИМ
		brne down
		rjmp	main		

Pause:
		ldi loop,	DelayMax		//Загрузили в петлю максимальное значение задержки
	P1:	ldi temp,	DelayMax		// прогрузили значение времени задержки
	P2:	dec	temp				//уменьшили значение регистра			
		brne P2					//Переход по условию «неравно»
		dec	loop				//
		brne P1					//Переход по условию «неравно»
		ret	
